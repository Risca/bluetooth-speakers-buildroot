## package/bluetooth-speakers/Config.in
```kconfig
comment "bluetooth-speakers needs an Open(E)GL-capable backend"
	depends on BR2_PACKAGE_QT5
	depends on BR2_PACKAGE_QT5_JSCORE_AVAILABLE
	depends on !BR2_PACKAGE_QT5_GL_AVAILABLE || !BR2_PACKAGE_HAS_LIBEGL

config BR2_PACKAGE_BLUETOOTH_SPEAKERS
	bool "bluetooth-speakers"
	depends on BR2_PACKAGE_HAS_LIBEGL # qt5base-eglfs
	depends on BR2_PACKAGE_QT5_GL_AVAILABLE
	# No comment needed for this option, it's an architecture
	# dependency.
	depends on BR2_PACKAGE_QT5_JSCORE_AVAILABLE
	select BR2_PACKAGE_QT5BASE_EGLFS
	select BR2_PACKAGE_QT5CONNECTIVITY
	select BR2_PACKAGE_QT5QUICKCONTROLS2
	help
	  Pair with bluetooth speakers
```

## package/bluez-alsa/Config.in
```kconfig
config BR2_PACKAGE_BLUEZ_ALSA
	bool "bluez-alsa"
	depends on BR2_PACKAGE_BLUEZ5_UTILS
	select BR2_PACKAGE_ALSA_LIB
	help
	  Bluetooth Audio ALSA Backend

	  This project is a rebirth of a direct integration between Bluez and
	  ALSA. Since Bluez >= 5, the build-in integration has been removed in
	  favor of 3rd party audio applications. From now on, Bluez acts as a
	  middleware between an audio application, which implements Bluetooth
	  audio profile, and a Bluetooth audio device.

	  https://github.com/Arkq/bluez-alsa

if BR2_PACKAGE_BLUEZ_ALSA

config BR2_PACKAGE_BLUEZ_ALSA_DEBUG
	bool "debugging"
	help
	  Enable bluez alsa debugging support

config BR2_PACKAGE_BLUEZ_ALSA_AAC
	bool "aac"
	select BR2_PACKAGE_FDK_AAC
	help
	  Enable (FDK) AAC support
endif
```

## package/fbcp-ili9341/Config.in
```kconfig
config BR2_PACKAGE_FBCP_ILI9341
	bool "fbcp-ili9341"
	depends on BR2_arm
	depends on BR2_PACKAGE_RPI_USERLAND
	help
	  This repository implements a driver for certain SPI-based LCD
	  displays for Raspberry Pi A, B, 2, 3 and Zero.

	  https://github.com/juj/fbcp-ili9341

comment "fbcp-ili9341 needs rpi-userland"
	depends on BR2_arm
	depends on !BR2_PACKAGE_RPI_USERLAND
```

## package/raspi2fb/Config.in
```kconfig
config BR2_PACKAGE_RASPI2FB
	bool "raspi2fb"
	depends on BR2_arm
	depends on BR2_PACKAGE_RPI_USERLAND
	select BR2_PACKAGE_LIBBSD
	help
	  Program to copy the Raspberry Pi display to a secondary
	  framebuffer.

	  https://github.com/AndrewFromMelbourne/raspi2fb

comment "raspi2fb needs rpi-userland"
	depends on BR2_arm
	depends on !BR2_PACKAGE_RPI_USERLAND
```
